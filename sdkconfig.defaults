## sdkconfig.defaults
```kconfig
# loader configs, disabled memory protection

# disable memory protection
CONFIG_ESP_SYSTEM_MEMPROT_FEATURE=n

CONFIG_TINYUSB_DESC_MANUFACTURER_STRING="VRC"
CONFIG_TINYUSB_DESC_PRODUCT_STRING="Neo v2"

# USB Communication Device Class (CDC)
CONFIG_TINYUSB_CDC_ENABLED=y
CONFIG_TINYUSB_CDC_COUNT=2
CONFIG_TINYUSB_CDC_RX_BUFSIZE=512
CONFIG_TINYUSB_CDC_TX_BUFSIZE=512


# micro-ROS Settings
CONFIG_MICRO_ROS_ESP_XRCE_DDS_MIDDLEWARE=y
# CONFIG_MICRO_ROS_ESP_EMBEDDEDRTPS_MIDDLEWARE is not set
# CONFIG_MICRO_ROS_ESP_NETIF_WLAN is not set
# CONFIG_MICRO_ROS_ESP_NETIF_ENET is not set
# CONFIG_MICRO_ROS_ESP_UART_TRANSPORT=y

CONFIG_ESP_WIFI_SSID="AAP"
CONFIG_ESP_WIFI_PASSWORD="Pawan123"
CONFIG_ESP_MAXIMUM_RETRY=5



# psram config for esp32s3 N16R8
#
# ESP PSRAM
#
CONFIG_SPIRAM=y

#
# SPI RAM config
#
# CONFIG_SPIRAM_MODE_QUAD is not set
CONFIG_SPIRAM_MODE_OCT=y
CONFIG_SPIRAM_TYPE_AUTO=y
# CONFIG_SPIRAM_TYPE_ESPPSRAM64 is not set
CONFIG_SPIRAM_ALLOW_STACK_EXTERNAL_MEMORY=y
CONFIG_SPIRAM_CLK_IO=30
CONFIG_SPIRAM_CS_IO=26
# CONFIG_SPIRAM_FETCH_INSTRUCTIONS is not set
# CONFIG_SPIRAM_RODATA is not set
CONFIG_SPIRAM_SPEED_80M=y
# CONFIG_SPIRAM_SPEED_40M is not set
CONFIG_SPIRAM_SPEED=80
# CONFIG_SPIRAM_ECC_ENABLE is not set
CONFIG_SPIRAM_BOOT_INIT=y
# CONFIG_SPIRAM_IGNORE_NOTFOUND is not set
# CONFIG_SPIRAM_USE_MEMMAP is not set
# CONFIG_SPIRAM_USE_CAPS_ALLOC is not set
CONFIG_SPIRAM_USE_MALLOC=y
CONFIG_SPIRAM_MEMTEST=y
CONFIG_SPIRAM_MALLOC_ALWAYSINTERNAL=16384
# CONFIG_SPIRAM_TRY_ALLOCATE_WIFI_LWIP is not set
CONFIG_SPIRAM_MALLOC_RESERVE_INTERNAL=32768
# CONFIG_SPIRAM_ALLOW_BSS_SEG_EXTERNAL_MEMORY is not set
# end of SPI RAM config
# end of ESP PSRAM


# set initial clock frequency
CONFIG_ESP_DEFAULT_CPU_FREQ_MHZ_240=y
CONFIG_ESP_DEFAULT_CPU_FREQ_MHZ=240


#enable c++ exceptions
CONFIG_COMPILER_CXX_EXCEPTIONS=y
CONFIG_COMPILER_CXX_EXCEPTIONS_EMG_POOL_SIZE=0

# implement custom file system 
CONFIG_PARTITION_TABLE_CUSTOM=y
CONFIG_PARTITION_TABLE_CUSTOM_FILENAME="partition-table.csv"
CONFIG_PARTITION_TABLE_FILENAME="partition-table.csv"

#set flash size to 16MB
CONFIG_ESPTOOLPY_FLASHSIZE_16MB=y
CONFIG_ESPTOOLPY_FLASHSIZE="16MB"
```
